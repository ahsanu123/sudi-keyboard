## development-board/NRF51822_Module/boards/nordic/mod22/board.yml
```yaml
board:
  name: mod22
  full_name: Module_NRF51822
  vendor: nordic
  socs:
  - name: nrf51822
```

## firmware/v2z/sudi-v2/boards/vendor/sudi/Kconfig.defconfig
```kconfig
# nRF51 DK NRF51822 board configuration

# Copyright (c) 2016 Linaro Limited.
# SPDX-License-Identifier: Apache-2.0

if BOARD_SUDI

config BT_CTLR
	default BT

endif # 
```

## firmware/v2z/sudi-v2/boards/vendor/sudi/Kconfig.sudi
```kconfig
# Copyright (c) 2023 Nordic Semiconductor ASA

# SPDX-License-Identifier: Apache-2.0

config BOARD_SUDI
	select SOC_NRF51822_QFAA
```

## firmware/v2z/sudi-v2/boards/vendor/sudi/sudi_defconfig
```kconfig
# SPDX-License-Identifier: Apache-2.0

# enable GPIO
CONFIG_GPIO=y

# enable uart driver
# CONFIG_SERIAL=y

# CONFIG_SHELL_BACKENDS=y
# CONFIG_SHELL=y

# HAS_SEGGER_RTT=y
# USE_SEGGER_RTT=y
```
